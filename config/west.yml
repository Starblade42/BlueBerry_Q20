## config/west.yml
```yaml
manifest:
  remotes:
    - name: zmkfirmware
      url-base: https://github.com/zmkfirmware
    - name: ZitaoTech
      url-base: https://github.com/ZitaoTech
  projects:
    - name: zmk
      remote: ZitaoTech
      revision: 7508420a681ab5ff5017b9a830197bf156628b42
      import: app/west.yml
  self:
    path: config
```
